## components/mdns_service/Kconfig
```kconfig
menu "mDNS configuration"

    config MDNS_HOST_NAME
        string "mDNS Host Name"
        default "lcu30h-home"
        help
            Specify the domain name used in the mDNS service.
            Note that webpage also take it as a part of URL where it will send GET/POST requests to.

    config MDNS_INSTANCE
        string "mDNS Instance Name"
        default "LCU30H Gate Automation"
        help
            mDNS Instance Name for example to use

endmenu
```

## components/softap_sta/Kconfig
```kconfig
menu "SoftAP and STA configuration"

  menu "SoftAP Configuration"
      comment "SoftAP Configuration"

      config ESP_WIFI_AP_SSID
          string "WiFi AP SSID"
          default "myssid"
          help
              SSID (network name) of the AP for the example to connect to.

      config ESP_WIFI_AP_PASSWORD
          string "WiFi AP Password"
          default "mypassword"
          help
              WiFi password of the AP for the example to use.

      config ESP_WIFI_AP_CHANNEL
          int "WiFi AP Channel"
          range 1 14
          default 1
          help
              WiFi channel (network channel) of the AP for the example to use.

      config ESP_MAX_STA_CONN_AP
          int "Maximal STA connections"
          default 4
          help
              Max number of the STA connects to AP.
  endmenu

  menu "STA configuration"
    config ESP_WIFI_REMOTE_AP_SSID
      string "WiFi Remote AP SSID"
      default "otherapssid"
      help
        SSID for the upstream AP that the ESP will connect to as a station.

    config ESP_WIFI_REMOTE_AP_PASSWORD
      string "WiFi Remote AP Password"
      default "otherapassword"
      help
        Password for the upstream AP.

    config ESP_MAXIMUM_STA_RETRY
      int "Maximum retry"
      default 5
      help
        Maximum number of reconnection attempts to the upstream AP.
  endmenu

endmenu
```
